#include "iWatch.h"

static unsigned char CODE Icon[] = {
	48, 48,
	0x00,0x00,0x00,0x00,0x00,0x00,0x00,0x00,0x00,0x00,0x00,0x00,0x00,0x00,0x00,0x00,
	0x00,0x00,0x00,0x00,0xF0,0xF8,0xF8,0xF8,0xF8,0xF0,0xF0,0xE0,0xC0,0xC0,0x80,0x00,
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	0x00,0x00,0x00,0x00,0x00,0x00,0x00,0x00,0x00,0x00,0x00,0x00,0x00,0x00,0x00,0x00
	/* (48 X 48 )*/
};
static t_psWidget text[2];
static t_psWidget bmp1;
static t_psGroup group1;

static char xdata rx4_buf[64];
static unsigned char xdata rx4_cnt = 0;
static char xdata rx1_buf[64];
static unsigned char xdata rx1_cnt = 0;
static unsigned char uart1_busy_flag = 0;
static unsigned char uart4_busy_flag = 0;
static unsigned char is_bluetooth_connected = 0;

/*
void Uart1Isr() interrupt 4
{
	if(TI)
	{
		TI = 0;
		uart1_busy_flag = 0;
	}
	if(RI)
	{
		RI = 0;
		rx1_buf[rx1_cnt++] = SBUF;
  }
}
*/
void Uart1SendChar(char c)
{
	while(uart1_busy_flag);
	uart1_busy_flag = 1;
	SBUF = c;
}
/*
void Uart4Isr() interrupt 18
{
	if (S4CON & 0x02)
  {
		S4CON &= ~0x02;
    uart4_busy_flag = 0;
  }
  if (S4CON & 0x01)	//接收中断
  {
		S4CON &= ~0x01;
    rx4_buf[rx4_cnt++] = S4BUF;
  }
}

void Uart4SendChar(char c)
{
	while(uart4_busy_flag);
	uart4_busy_flag = 1;
	S4BUF = c;
}
void Uart4SendStr(char *p)
{
	while (*p)
  {
		Uart4SendChar(*p++);
  }
}
*/
/**
  * @brief  页面初始化事件
  * @param  无
  * @retval 无
  */
static void Setup(unsigned char condition)
{
	unsigned int i = 0;
	text[0] = og_lable_create("nmsl", FONT_ASCII_7X8, 128, 0);
	og_anim_create(text[0], 0, 0, ANIM_TIME_NORM, NULL);
	for(i = 0; i < 64; i++)
	{
		rx1_buf[i] = 0;
		rx4_buf[i] = 0;
	}
	rx1_cnt = 0;
	rx4_cnt = 0;
	IE2 |= 0x10;		//开串口4接收中断
	ES = 1;					//开串口1接收中断
	P3 |= 0x03;
}
static void delet(void)
{
	//group_delet(group1);
	pageSetStatus(PAGE_IDLE);
	og_widget_delet(text[0]);
}
/**
  * @brief  页面退出事件
  * @param  无
  * @retval 无
  */
static void Exit(unsigned char condition)
{
	og_anim_create(text[0], 128, 0, ANIM_TIME_NORM, delet);
	IE2 &= ~0x10;		//关串口4接收中断
	ES = 0;					//关串口1接收中断
	P3 &= ~0x03;
}
/**
  * @brief  页面循环执行的内容
  * @param  无
  * @retval 无
  */
static void Loop()
{
	if(pageExecuteRate(&Rate10Hz))
	{
		if(rx4_cnt != 0)
		{
			unsigned char index = 0;
			while(index != rx4_cnt)
			{
				Uart1SendChar(rx4_buf[index++]);
			}
			rx4_cnt = 0;
		}
		if(rx1_cnt != 0)
		{
			unsigned char index = 0;
			while(index != rx1_cnt)
			{
				Uart4SendChar(rx1_buf[index++]);
			}
			rx1_cnt = 0;
		}
	}
	if(is_bluetooth_connected == 0)
	{
		if(BTSTA)
		{
			is_bluetooth_connected = 1;
		}
	}
	else
	{
		if(BTSTA == 0)
		{
			is_bluetooth_connected = 0;
		}
	}
}
/**
  * @brief  页面事件
  * @param  btn:发出事件的按键
  * @param  event:事件编号
  * @retval 无
  */
static void Event(unsigned char event)
{
	if(event == KEY1_PRESSED)
		pageShift(page_menu, PAGE_RETURN);
	else if(event == KEY2_PRESSED)
		Uart4SendStr("AT+TD\r\n");
	else if(event == KEY3_PRESSED)
		Uart4SendStr("AT+QT\r\n");
}
void pageRegister_page_bluetooth(unsigned char pageID)
{
	pageRegister(pageID, "BLUETOOTH", Icon, Setup, Loop, Exit, Event);
}