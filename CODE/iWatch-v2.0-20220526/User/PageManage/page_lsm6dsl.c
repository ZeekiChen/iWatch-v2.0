#include "iWatch.h"

static unsigned char CODE Icon[] = {
	48, 48,
	0x00,0x00,0x00,0x00,0x00,0x00,0x00,0x00,0x00,0x00,0x00,0x80,0xC0,0xC0,0x60,0x60,
	0x30,0x30,0x10,0x18,0x18,0x18,0x18,0x18,0x18,0x18,0x18,0x18,0x18,0x30,0x30,0x30,
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	0x06,0x03,0x03,0x01,0x00,0x00,0x00,0x00,0x00,0x00,0x00,0x00,0x00,0x00,0x00,0x00
	/* (48 X 48 )*/
};
static t_psWidget text1, text2;
static t_psWidget slider1, slider2;
static t_psGroup group1;

static int g[3] = {0, 0, 0};


/**
  * @brief  页面初始化事件
  * @param  无
  * @retval 无
  */
static void Setup(unsigned char condition)
{
	text1 = og_label_create(FONT_GB2312_15X16, 0, 0);
	text2 = og_label_create(FONT_ASCII_8X16, 0, 16);
	og_label_setText(text1, "姿态角：");
	og_label_setText(text2, "x:00.0, y:00.0");
	slider1 = og_slider_create(-90, 90, 0, 128, 0, 32);
	slider2 = og_slider_create(-90, 90, 0, 128, 0, 48);
	group1 = og_group_create(4);
	og_group_addWidget(group1, text1, 0);
	og_group_addWidget(group1, text2, 0);
	og_group_addWidget(group1, slider1, 0);
	og_group_addWidget(group1, slider2, 0);
	og_group_setPosOffset(group1, 0, OLED_HEIGHT);
	og_group_addAnimOffset(group1, 0, -OLED_HEIGHT, ANIM_TIME_NORM, ANIM_NULL_CB);
	LSM6DSMConfigAcc(ACC_ODR_208_HZ, ACC_SCALE_4_G);
	LSM6DSMConfigGyr(GYR_ODR_208_HZ, GYR_SCALE_500_DPS);
}
static void delet(void)
{
	og_group_delet(group1);
	pageSetStatus(page_lsm6dsl, PAGE_IDLE);
}
/**
  * @brief  页面退出事件
  * @param  无
  * @retval 无
  */
static void Exit(unsigned char condition)
{
	if(config.lsm6dsm_cfg == 0)
		LSM6DSMConfigAcc(ACC_POWER_DOWN, ACC_SCALE_4_G);
	else
		LSM6DSMConfigAcc(ACC_ODR_26_HZ, ACC_SCALE_4_G);
	LSM6DSMConfigGyr(GYR_POWER_DOWN, GYR_SCALE_500_DPS);
	og_group_addAnimOffset(group1, 0, OLED_HEIGHT, ANIM_TIME_NORM, delet);
}
/**
  * @brief  页面循环执行的内容
  * @param  无
  * @retval 无
  */
static void Loop()
{
	if(pageExecuteRate(&Rate100Hz))
	{
		LSM6DSMReadGYRAndACC(&LSM6DSM);
		LSM6DSM.gyr_x -= g[0];
		LSM6DSM.gyr_y -= g[1];
		LSM6DSM.gyr_z -= g[2];
		IMUupdate(&LSM6DSM);
	}
	if(pageExecuteRate(&Rate50Hz))
	{
		lablel_printf(text2, "X:%5.1f,Y:%5.1f", LSM6DSM.AngleX + 0.05, LSM6DSM.AngleY + 0.05);
		og_slider_setValue(slider1, LSM6DSM.AngleX);
		og_slider_setValue(slider2, LSM6DSM.AngleY);
		//printf("%.1f#%.1f#%.1f\r\n", LSM6DSM.AngleX, LSM6DSM.AngleY, LSM6DSM.AngleZ);
	}
}
/**
  * @brief  页面事件
  * @param  btn:发出事件的按键
  * @param  event:事件编号
  * @retval 无
  */
static void Event(unsigned char event)
{
	if(event == KEY1_PRESSED)
		pageShift(page_menu, PAGE_RETURN);
	else if(event == KEY2_PRESSED)
	{
		g[0] = LSM6DSM.gyr_x;
		g[1] = LSM6DSM.gyr_y;
		g[2] = LSM6DSM.gyr_z;
	}
}
void pageRegister_page_lsm6dsl(unsigned char pageID)
{
	pageRegister(pageID, "LSM6DSL", Icon, Setup, Loop, Exit, Event);
}