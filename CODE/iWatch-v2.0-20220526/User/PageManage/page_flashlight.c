#include "iWatch.h"

static unsigned char CODE Icon[] = {
	48, 48,
	0x00,0x00,0x00,0x00,0x00,0x00,0x00,0x00,0x00,0x00,0x00,0x00,0x00,0x00,0x00,0x00,
	0x00,0x00,0x00,0x00,0x00,0x00,0x00,0x00,0x00,0x80,0xC0,0xC0,0x80,0x00,0x00,0x00,
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	0x00,0x00,0x00,0x00,0x00,0x00,0x00,0x00,0x00,0x00,0x00,0x00,0x00,0x00,0x00,0x00
	/* (48 X 48 )*/
};
static t_psWidget text1;
static unsigned char fq = 0;
static t_sPageRate flashRate = {0, 0};


/**
  * @brief  页面初始化事件
  * @param  无
  * @retval 无
  */
static void Setup(unsigned char condition)
{
	text1 = og_label_create(FONT_ASCII_8X16, 32, 88);
	og_label_setText(text1, "0Hz");
	og_widget_setPos(text1, 64 - text1->w/2, text1->y);
	og_anim_create_offset(text1, 0, -64, ANIM_TIME_NORM, ANIM_NULL_CB);
	OLED_Inverse(1);
	OLED_Set_Brightness(0XFF);
}
static void delet(void)
{
	og_widget_delet(text1);
	pageSetStatus(page_flashlight, PAGE_IDLE);
}
/**
  * @brief  页面退出事件
  * @param  无
  * @retval 无
  */
static void Exit(unsigned char condition)
{
	OLED_setBreathing(0, 0);
	OLED_Inverse(config.screen_inverse);
	OLED_Set_Brightness((config.screen_brightness - 1) * 50 + 1);
	og_anim_create_offset(text1, 0, 64, ANIM_TIME_NORM, delet);
}
/**
  * @brief  页面循环执行的内容
  * @param  无
  * @retval 无
  */
static void Loop()
{
	static unsigned char k = 0;
	iWatchKeepActive();
	if(fq != 0)
	{
		if(pageExecuteRate(&flashRate))
		{
			OLED_Inverse(k);
			k = ~k;
		}
	}
}
/**
  * @brief  页面事件
  * @param  btn:发出事件的按键
  * @param  event:事件编号
  * @retval 无
  */
static void Event(unsigned char event)
{
	if(event == KEY1_PRESSED)
		pageShift(page_menu, PAGE_RETURN);
	else
	{
		if(event == KEY2_PRESSED)
		{
			if(++fq == 11)
			{
				fq = 0;
				OLED_Inverse(1);
			}
		}
		else if(event == KEY4_PRESSED)
		{	
			if(--fq == 0xff)
					fq = 10;
		}
		lablel_printf(text1, "%uHz", fq);
		og_widget_setPos(text1, 64 - text1->w/2, text1->y);
		if(fq != 0)
		{
			flashRate.executeT = 1000/fq/2;
		}
	}
	
}
void pageRegister_page_flashlight(unsigned char pageID)
{
	pageRegister(pageID, "FLASH LIGHT", Icon, Setup, Loop, Exit, Event);
}